// SPDX-License-Identifier:
/*
 * Copyright 2023 - Nuvoton Technology Corporation
 *
 */

/dts-v1/;
#include "ma35h0.dtsi"

/ {
	model = "Nuvoton MA35H0 EVB board";
	compatible = "nuvoton,ma35h0";

	aliases {

	};

	ddr: ddr-controller {
		compatible = "custom-ddr";
	};

};

&sspcc {
	gpio_s = <PD6_S>,
		<PD7_S>;
};
